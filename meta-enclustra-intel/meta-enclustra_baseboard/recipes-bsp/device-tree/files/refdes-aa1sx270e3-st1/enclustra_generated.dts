// SPDX-License-Identifier: GPL-2.0-only
/*
 * Copyright (C) 2023 Enclustra GmbH
 */

/dts-v1/;

#include "ME-AA1-270-3E4-D11E-NFX3.dtsi"
#include "socfpga_arria10.dtsi"
#include "socfpga_enclustra_mercury_aa1.dtsi"
#include "socfpga_enclustra_mercury_st1.dtsi"
