/* AUTOGENERATED FILE - DO NOT MODIFY */
/* This file is created by Enclustra Build Environment */

/dts-v1/;

#include "ME-SA1-C6-7I-D10.dtsi"
#include "socfpga_cyclone5.dtsi"
#include "socfpga-common-u-boot.dtsi"
#include "socfpga_enclustra_mercury_sa1.dtsi"
