## meta-enclustra-refdes/conf/machine/me-pe1-generic.conf
```bitbake
## machine.conf for the pe1 carrier board

## preamble
MACHINEOVERRIDES =. "${@['', 'me-pe1-generic:']['me-pe1-generic' != '${MACHINE}']}"

## postabmle
PACKAGE_EXTRA_ARCHS:append = "${@['', ' me-pe1-generic']['me-pe1-generic' != "${MACHINE}"]}"
```

## meta-enclustra-refdes/conf/machine/me-pe3-generic.conf
```bitbake
## machine.conf for the pe3 carrier board

## preamble
MACHINEOVERRIDES =. "${@['', 'me-pe3-generic:']['me-pe3-generic' != '${MACHINE}']}"

## postabmle
PACKAGE_EXTRA_ARCHS:append = "${@['', ' me-pe3-generic']['me-pe3-generic' != "${MACHINE}"]}"
```

## meta-enclustra-refdes/conf/machine/refdes-aa1sx270i2-pe3.conf
```bitbake
#@TYPE: Machine
#@NAME: refdes-aa1sx270i2-pe3
#@DESCRIPTION: Machine configuration for the refdes-aa1sx270i2-pe3 boards.

#### Preamble
MACHINEOVERRIDES =. "${@['', 'refdes-aa1sx270i2-pe3:']['refdes-aa1sx270i2-pe3' !='${MACHINE}']}"
#### Regular settings follow

# Required generic machine inclusion
require conf/machine/aa1sx270i2-module.conf
require conf/machine/pe3-generic.conf

#### No additional settings should be after the Postamble
#### Postamble
PACKAGE_EXTRA_ARCHS:append = "${@['', 'refdes_aa1sx270i2_pe3']['refdes-aa1sx270i2-pe3' != '${MACHINE}']}"
```

## meta-enclustra-refdes/conf/machine/refdes-me-aa1-270-2i2-d11e-nfx3-pe1.conf
```bitbake
#@TYPE: Machine
#@NAME: refdes-me-aa1-270-2i2-d11e-nfx3-pe1
#@DESCRIPTION: Machine configuration for the refdes-me-aa1-270-2i2-d11e-nfx3-pe1 boards.

#### Preamble
MACHINEOVERRIDES =. "${@['', 'refdes-me-aa1-270-2i2-d11e-nfx3-pe1:']['refdes-me-aa1-270-2i2-d11e-nfx3-pe1' !='${MACHINE}']}"
#### Regular settings follow

# Required generic machine inclusion
require conf/machine/me-aa1-270-2i2-d11d-nfx3.conf
require conf/machine/me-pe1-generic.conf

#### No additional settings should be after the Postamble
#### Postamble
PACKAGE_EXTRA_ARCHS:append = "${@['', ' refdes_me-aa1-270-2i2-d11e-nfx3_pe1']['refdes-me-aa1-270-2i2-d11e-nfx3-pe1' != '${MACHINE}']}"
```

## meta-enclustra-refdes/conf/machine/refdes-me-aa1-270-2i2-d11e-nfx3-pe3.conf
```bitbake
#@TYPE: Machine
#@NAME: refdes-me-aa1-270-2i2-d11e-nfx3-pe3
#@DESCRIPTION: Machine configuration for the refdes-me-aa1-270-2i2-d11e-nfx3-pe3 boards.

#### Preamble
MACHINEOVERRIDES =. "${@['', 'refdes-me-aa1-270-2i2-d11e-nfx3-pe3:']['refdes-me-aa1-270-2i2-d11e-nfx3-pe3' !='${MACHINE}']}"
#### Regular settings follow

# Required generic machine inclusion
require conf/machine/me-aa1-270-2i2-d11e-nfx3.conf
require conf/machine/me-pe3-generic.conf

#### No additional settings should be after the Postamble
#### Postamble
PACKAGE_EXTRA_ARCHS:append = "${@['', ' refdes_me-aa1-270-2i2-d11e-nfx3_pe3']['refdes-me-aa1-270-2i2-d11e-nfx3-pe3' != '${MACHINE}']}"
```

## meta-enclustra-refdes/conf/machine/refdes-me-aa1-270-2i2-d11e-nfx3-st1.conf
```bitbake
#@TYPE: Machine
#@NAME: refdes-me-aa1-270-2i2-d11e-nfx3-st1
#@DESCRIPTION: Machine configuration for the refdes-me-aa1-270-2i2-d11e-nfx3-st1 boards.

#### Preamble
MACHINEOVERRIDES =. "${@['', 'refdes-me-aa1-270-2i2-d11e-nfx3-st1:']['refdes-me-aa1-270-2i2-d11e-nfx3-st1' !='${MACHINE}']}"
#### Regular settings follow

# Required generic machine inclusion
require conf/machine/me-aa1-270-2i2-d11d-nfx3.conf
require conf/machine/me-st1-generic.conf

#### No additional settings should be after the Postamble
#### Postamble
PACKAGE_EXTRA_ARCHS:append = "${@['', ' refdes_me-aa1-270-2i2-d11e-nfx3_st1']['refdes-me-aa1-270-2i2-d11e-nfx3-st1' != '${MACHINE}']}"
```

## meta-enclustra-refdes/conf/machine/refdes-me-sa1-c6-7i-d10-pe1.conf
```bitbake
#@TYPE: Machine
#@NAME: refdes-me-sa1-c6-7i-d10-pe1
#@DESCRIPTION: Machine configuration for the refdes-me-sa1-c6-7i-d10-pe1 boards.

#### Preamble
MACHINEOVERRIDES =. "${@['', 'refdes-me-sa1-c6-7i-d10-pe1:']['refdes-me-sa1-c6-7i-d10-pe1' !='${MACHINE}']}"
#### Regular settings follow

# Required generic machine inclusion
require conf/machine/me-sa1-c6-7i-d10.conf
require conf/machine/me-pe1-generic.conf

#### No additional settings should be after the Postamble
#### Postamble
PACKAGE_EXTRA_ARCHS:append = "${@['', ' refdes_me-sa1-c6-7i-d10_pe1']['refdes-me-sa1-c6-7i-d10-pe1' != '${MACHINE}']}"
```

## meta-enclustra-refdes/conf/machine/refdes-me-sa1-c6-7i-d10-pe3.conf
```bitbake
#@TYPE: Machine
#@NAME: refdes-me-sa1-c6-7i-d10-pe3
#@DESCRIPTION: Machine configuration for the refdes-me-sa1-c6-7i-d10-pe3 boards.

#### Preamble
MACHINEOVERRIDES =. "${@['', 'refdes-me-sa1-c6-7i-d10-pe3:']['refdes-me-sa1-c6-7i-d10-pe3' !='${MACHINE}']}"
#### Regular settings follow

# Required generic machine inclusion
require conf/machine/me-sa1-c6-7i-d10.conf
require conf/machine/me-pe3-generic.conf

WKS_FILE ?= "sdimage-enclustra-cyclonev.wks"
IMAGE_FSTYPES:append = " wic"

#### No additional settings should be after the Postamble
#### Postamble
PACKAGE_EXTRA_ARCHS:append = "${@['', ' refdes_me-sa1-c6-7i-d10_pe3']['refdes-me-sa1-c6-7i-d10-pe3' != '${MACHINE}']}"
```

## meta-enclustra-refdes/conf/machine/refdes-me-sa1-c6-7i-d10-st1.conf
```bitbake
#@TYPE: Machine
#@NAME: refdes-me-sa1-c6-7i-d10-st1
#@DESCRIPTION: Machine configuration for the refdes-me-sa1-c6-7i-d10-st1 boards.

#### Preamble
MACHINEOVERRIDES =. "${@['', 'refdes-me-sa1-c6-7i-d10-st1:']['refdes-me-sa1-c6-7i-d10-st1' !='${MACHINE}']}"
#### Regular settings follow

# Required generic machine inclusion
require conf/machine/me-sa2-d6-7i-d11.conf
require conf/machine/me-st1-generic.conf

WKS_FILE ?= "sdimage-enclustra-cyclonev.wks"
IMAGE_FSTYPES:append = " wic"

#### No additional settings should be after the Postamble
#### Postamble
PACKAGE_EXTRA_ARCHS:append = "${@['', ' refdes_me-sa1-c6-7i-d10_st1']['refdes-me-sa1-c6-7i-d10-st1' != '${MACHINE}']}"
```

## meta-enclustra-refdes/conf/machine/refdes-me-sa2-d6-7i-d11-pe1.conf
```bitbake
#@TYPE: Machine
#@NAME: refdes-me-sa2-d6-7i-d11-pe1
#@DESCRIPTION: Machine configuration for the refdes-me-sa2-d6-7i-d11-pe1 boards.

#### Preamble
MACHINEOVERRIDES =. "${@['', 'refdes-me-sa2-d6-7i-d11-pe1:']['refdes-me-sa2-d6-7i-d11-pe1' !='${MACHINE}']}"
#### Regular settings follow

# Required generic machine inclusion
require conf/machine/me-sa2-d6-7i-d11.conf
require conf/machine/me-pe1-generic.conf

WKS_FILE ?= "sdimage-enclustra-cyclonev.wks"
IMAGE_FSTYPES:append = " wic"

#### No additional settings should be after the Postamble
#### Postamble
PACKAGE_EXTRA_ARCHS:append = "${@['', ' refdes_me-sa2-d6-7i-d11_pe1']['refdes-me-sa2-d6-7i-d11-pe1' != '${MACHINE}']}"
```

## meta-enclustra-refdes/conf/machine/refdes-me-sa2-d6-7i-d11-pe3.conf
```bitbake
#@TYPE: Machine
#@NAME: refdes-me-sa2-d6-7i-d11-pe3
#@DESCRIPTION: Machine configuration for the refdes-me-sa2-d6-7i-d11-pe3 boards.

#### Preamble
MACHINEOVERRIDES =. "${@['', 'refdes-me-sa2-d6-7i-d11-pe3:']['refdes-me-sa2-d6-7i-d11-pe3' !='${MACHINE}']}"
#### Regular settings follow

# Required generic machine inclusion
require conf/machine/me-sa2-d6-7i-d11.conf
require conf/machine/me-pe3-generic.conf

WKS_FILE ?= "sdimage-enclustra-cyclonev.wks"
IMAGE_FSTYPES:append = " wic"

#### No additional settings should be after the Postamble
#### Postamble
PACKAGE_EXTRA_ARCHS:append = "${@['', ' refdes_me-sa2-d6-7i-d11_pe3']['refdes-me-sa2-d6-7i-d11-pe3' != '${MACHINE}']}"
```

## meta-enclustra-refdes/conf/machine/refdes-me-sa2-d6-7i-d11-st1.conf
```bitbake
#@TYPE: Machine
#@NAME: refdes-me-sa2-d6-7i-d11-st1
#@DESCRIPTION: Machine configuration for the refdes-me-sa2-d6-7i-d11-st1 boards.

#### Preamble
MACHINEOVERRIDES =. "${@['', 'refdes-me-sa2-d6-7i-d11-st1:']['refdes-me-sa2-d6-7i-d11-st1' !='${MACHINE}']}"
#### Regular settings follow

# Required generic machine inclusion
require conf/machine/me-sa2-d6-7i-d11.conf
require conf/machine/me-st1-generic.conf

#### No additional settings should be after the Postamble
#### Postamble
PACKAGE_EXTRA_ARCHS:append = "${@['', ' refdes_me-sa2-d6-7i-d11_st1']['refdes-me-sa2-d6-7i-d11-st1' != '${MACHINE}']}"
```

## meta-enclustra-refdes/conf/machine/refdes-sa2-pe3.conf
```bitbake
#@TYPE: Machine
#@NAME: refdes-sa2-pe3
#@DESCRIPTION: Machine configuration for the refdes-sa2-pe3 boards.

#### Preamble
MACHINEOVERRIDES =. "${@['', 'refdes-sa2-pe3:']['refdes-sa2-pe3' !='${MACHINE}']}"
#### Regular settings follow

# Required generic machine inclusion
require conf/machine/sa2-module.conf
require conf/machine/pe3-generic.conf

#### No additional settings should be after the Postamble
#### Postamble
PACKAGE_EXTRA_ARCHS:append = "${@['', 'refdes_sa2_pe3']['refdes-sa2-pe3' != '${MACHINE}']}"
```

## meta-enclustra-refdes/wic/sdimage-enclustra-cyclonev.wks
```
part --source bootimg-partition --ondisk mmcblk --fstype=vfat --mkfs-extraopts "-F 32" --label boot --active --align 1024 --fixed-size 100M --system-id b
part --source rawcopy --sourceparams="file=u-boot-with-spl.sfp" --ondisk mmcblk --system-id=a2 --align 1024 --fixed-size 2M
part / --source rootfs --ondisk mmcblk --fstype=ext4 --label root --align 1024 --fixed-size 500M
```

## meta-enclustra-socfpga/conf/layer.conf
```bitbake
# We have a conf and classes directory, add to BBPATH
BBPATH .= ":${LAYERDIR}"

# We have recipes-* directories, add to BBFILES
BBFILES += "${LAYERDIR}/recipes-*/*/*.bb \
            ${LAYERDIR}/recipes-*/*/*.bbappend"

BBFILE_COLLECTIONS += "meta-enclustra-socfpga"
BBFILE_PATTERN_meta-enclustra-socfpga = "^${LAYERDIR}/"
BBFILE_PRIORITY_meta-enclustra-socfpga = "2"

LAYERDEPENDS_meta-enclustra-socfpga += "meta-intel-fpga"

LAYERSERIES_COMPAT_meta-enclustra-socfpga = "honister"
```

## meta-enclustra-socfpga/conf/machine/mercury-aa1.conf
```bitbake
#@TYPE: Machine
#@NAME: Intel SoCFPGA Arria10
#@DESCRIPTION: Machine configuration for the Arria 10 SoCFPGA

require conf/machine/include/socfpga.inc

SPL_BINARY = "spl/u-boot-splx4.sfp"

UBOOT_CONFIG ??= "mercury-aa1-qspi"
UBOOT_CONFIG[mercury-aa1-qspi] = "mercury-aa1-qspi_defconfig"

KERNEL_IMAGETYPE = "uImage"
KERNEL_EXTRA_ARGS += "LOADADDR=0x8000"

IMAGE_FSTYPES = "cpio.gz.u-boot"

EXTRA_IMAGEDEPENDS += "\
	device-tree \
	u-boot-socfpga \
	u-boot-socfpga-env \
	u-boot-socfpga-scr \
	hw-ref-design \
	"

SERIAL_CONSOLES ?= "115200;ttyS0"
```

## meta-enclustra-socfpga/conf/machine/mercury-sa2.conf
```bitbake
require conf/machine/include/socfpga.inc

UBOOT_CONFIG ??= "mercury-sa2-sd"
UBOOT_CONFIG[mercury-sa2-sd] = "mercury-sa2-sd_defconfig"

KERNEL_IMAGETYPE = "uImage"
KERNEL_EXTRA_ARGS += "LOADADDR=0x8000"

IMAGE_FSTYPES = "tar.gz"

EXTRA_IMAGEDEPENDS += "\
	device-tree \
	u-boot-socfpga \
	u-boot-socfpga-env \
	u-boot-socfpga-scr \
	hw-ref-design \
	"

IMAGE_BOOT_FILES ?= " \
	mercury-sa2.dtb \
	boot.scr \
	uboot.env \
	fpga.rbf \
	${KERNEL_IMAGETYPE} \
	"

WKS_FILE ?= "sdimage-cyclone5-arria5.wks"
IMAGE_FSTYPES:append = " wic"

SERIAL_CONSOLES ?= "115200;ttyS0"
```

## meta-enclustra_intel/conf/machine/mercury-sa2.conf
```bitbake
require conf/machine/include/socfpga.inc

UBOOT_CONFIG ??= "mercury-sa2-sd"
UBOOT_CONFIG[mercury-sa2-sd] = "mercury-sa2-sd_defconfig"
UBOOT_CONFIG[mercury-sa2-qspi] = "mercury-sa2-qspi_defconfig"

KERNEL_IMAGETYPE = "uImage"
KERNEL_EXTRA_ARGS += "LOADADDR=0x8000"

IMAGE_FSTYPES = "cpio.gz.u-boot tar.gz"

EXTRA_IMAGEDEPENDS += "\
	device-tree \
	u-boot-socfpga \
	u-boot-socfpga-env \
	u-boot-socfpga-scr \
	hw-ref-design \
	"

IMAGE_BOOT_FILES ?= " \
	devicetree.dtb \
	boot-sd.scr \
	uboot.env \
	fpga.rbf \
	${KERNEL_IMAGETYPE} \
	"

WKS_FILE ?= "sdimage-cyclone5-arria5.wks"
IMAGE_FSTYPES:append = " wic"

SERIAL_CONSOLES ?= "115200;ttyS0"
```
