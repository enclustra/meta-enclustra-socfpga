/* AUTOGENERATED FILE - DO NOT MODIFY */
/* This file is created by Enclustra Build Environment */

/dts-v1/;

#include "ME-SA2-D6-7I-D11.dtsi"
#include "socfpga_cyclone5.dtsi"
#include "socfpga-common-u-boot.dtsi"
#include "socfpga_enclustra_mercury_sa2.dtsi"
