/* AUTOGENERATED FILE - DO NOT MODIFY */
/* This file is created by Enclustra Build Environment */

/dts-v1/;

#include "socfpga_arria10.dtsi"
#include "socfpga_enclustra_mercury_aa1.dtsi"
#include "socfpga_enclustra_mercury_pe1.dtsi"
#include "socfpga_enclustra_mercury_aa1_sdmmc_boot.dtsi"
#include "ME-AA1-480-2I3-D12E-NFX3.dtsi"
