## meta-enclustra-module/conf/machine/me-sa2-d6-7i-d11.conf
```bitbake
#@TYPE: Machine
#@NAME: Intel SoCFPGA CycloneV SA2
#@DESCRIPTION: Machine configuration for the CycloneV SA2 SoCFPGA

## override preamble
MACHINEOVERRIDES =. "${@['', 'me-sa2-d6-7i-d11:']['me-sa2-d6-7i-d11' != '${MACHINE}']}"


require me-sa2-generic.conf


## override postamble
PACKAGE_EXTRA_ARCHS:append = "${@['', ' me-sa2-d6-7i-d11']['me-sa2-d6-7i-d11' != "${MACHINE}"]}"
```

## meta-enclustra-module/conf/machine/me-sa2-generic.conf
```bitbake
#@TYPE: Machine
#@NAME: Intel SoCFPGA CycloneV SA2
#@DESCRIPTION: Machine configuration for the CycloneV SA2 SoCFPGA

## override preamble
MACHINEOVERRIDES =. "${@['', 'me-sa2-generic:']['me-sa2-generic' != '${MACHINE}']}"


require conf/machine/include/socfpga.inc

UBOOT_CONFIG ??= "sdmmc"
UBOOT_CONFIG[sdmmc] = "socfpga_enclustra_mercury_sa2_mmc_defconfig"
UBOOT_CONFIG[qspi]  = "socfpga_enclustra_mercury_sa2_qspi_defconfig"

KERNEL_IMAGETYPE = "uImage"
KERNEL_EXTRA_ARGS += "LOADADDR=0x8000"

IMAGE_FSTYPES = "cpio.gz.u-boot tar.gz wic.bmap"

EXTRA_IMAGEDEPENDS += "\
    device-tree \
    u-boot-socfpga \
    exported-binaries \
"

IMAGE_BOOT_FILES ?= " \
    devicetree.dtb \
    boot.scr \
    fpga.rbf \
    ${KERNEL_IMAGETYPE} \
"

SERIAL_CONSOLES ?= "115200;ttyS0"

## override postamble
PACKAGE_EXTRA_ARCHS:append = "${@['', ' me-sa2-generic']['me-sa2-generic' != "${MACHINE}"]}"
```

## meta-enclustra-module/conf/machine/sa1-module.conf
```bitbake
#@TYPE: Machine
#@NAME: Intel SoCFPGA CycloneV SA1
#@DESCRIPTION: Machine configuration for the Cyclone V SA1 SoCFPGA

## override preamble
MACHINEOVERRIDES =. "${@['', 'sa1-module:']['sa1-module' != '${MACHINE}']}"


require conf/machine/include/socfpga.inc

UBOOT_CONFIG ??= "sdmmc"
UBOOT_CONFIG[sdmmc] = "socfpga_enclustra_mercury_sa1_mmc_defconfig"
UBOOT_CONFIG[emmc]  = "socfpga_enclustra_mercury_sa1_mmc_defconfig"
UBOOT_CONFIG[qspi]  = "socfpga_enclustra_mercury_sa1_qspi_defconfig"

KERNEL_IMAGETYPE = "uImage"
KERNEL_EXTRA_ARGS += "LOADADDR=0x8000"

IMAGE_FSTYPES = "cpio.gz.u-boot tar.gz wic.bmap"

EXTRA_IMAGEDEPENDS += "\
	device-tree \
	u-boot-socfpga \
	hw-ref-design \
	"

IMAGE_BOOT_FILES ?= " \
	devicetree.dtb \
	boot.scr \
	fpga.rbf \
	${KERNEL_IMAGETYPE} \
	"

WKS_FILE ?= "sdimage-cyclone5-arria5.wks"
IMAGE_FSTYPES:append = " wic"

SERIAL_CONSOLES ?= "115200;ttyS0"


## override postamble
PACKAGE_EXTRA_ARCHS:append = "${@['', ' sa1_module']['sa1-module' != "${MACHINE}"]}"
```
