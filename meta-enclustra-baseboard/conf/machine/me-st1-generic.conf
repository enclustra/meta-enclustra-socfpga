## meta-enclustra-baseboard/conf/machine/me-st1-generic.conf
```bitbake
## machine.conf for the st1 carrier board

## preamble
MACHINEOVERRIDES =. "${@['', 'me-st1-generic:']['me-st1-generic' != '${MACHINE}']}"

## based on:
#require conf/machine/zynqmp-generic.conf

## postabmle
PACKAGE_EXTRA_ARCHS:append = "${@['', ' me-st1-generic']['me-st1-generic' != "${MACHINE}"]}"
```

## meta-enclustra-intel/meta-enclustra-baseboard/conf/machine/refdes-aa1sx270e3-pe3.conf
```bitbake
#@TYPE: Machine
#@NAME: refdes-aa1sx270e3-pe3
#@DESCRIPTION: Machine configuration for the refdes-aa1sx270e3-pe3 boards.

#### Preamble
MACHINEOVERRIDES =. "${@['', 'refdes-aa1sx270e3-pe3:']['refdes-aa1sx270e3-pe3' !='${MACHINE}']}"
#### Regular settings follow

# Required generic machine inclusion
require conf/machine/aa1sx270e3-module.conf
require pe3-generic.conf

#### No additional settings should be after the Postamble
#### Postamble
PACKAGE_EXTRA_ARCHS:append = "${@['', 'refdes_aa1sx270e3_pe3']['refdes-aa1sx270e3-pe3' != '${MACHINE}']}"
```

## meta-enclustra-intel/meta-enclustra-baseboard/conf/machine/refdes-aa1sx270e3-st1.conf
```bitbake
#@TYPE: Machine
#@NAME: refdes-aa1sx270e3-st1
#@DESCRIPTION: Machine configuration for the refdes-aa1sx270e3-st1 boards.

#### Preamble
MACHINEOVERRIDES =. "${@['', 'refdes-aa1sx270e3-st1:']['refdes-aa1sx270e3-st1' !='${MACHINE}']}"
#### Regular settings follow

# Required generic machine inclusion
require conf/machine/aa1sx270e3-module.conf
require st1-generic.conf

#### No additional settings should be after the Postamble
#### Postamble
PACKAGE_EXTRA_ARCHS:append = "${@['', 'refdes_aa1sx270e3_st1']['refdes-aa1sx270e3-st1' != '${MACHINE}']}"
```

## meta-enclustra-intel/meta-enclustra-baseboard/conf/machine/refdes-sa1-pe1.conf
```bitbake
#@TYPE: Machine
#@NAME: refdes-sa1-pe1
#@DESCRIPTION: Machine configuration for the refdes-sa1-pe1 boards.

#### Preamble
MACHINEOVERRIDES =. "${@['', 'refdes-sa1-pe1:']['refdes-sa1-pe1' !='${MACHINE}']}"
#### Regular settings follow

# Required generic machine inclusion
require conf/machine/sa1-module.conf
require pe1-generic.conf

#### No additional settings should be after the Postamble
#### Postamble
PACKAGE_EXTRA_ARCHS:append = "${@['', 'refdes_sa1_pe1']['refdes-sa1-pe1' != '${MACHINE}']}"
```

## meta-enclustra-intel/meta-enclustra-baseboard/conf/machine/refdes-sa1-st1.conf
```bitbake
#@TYPE: Machine
#@NAME: refdes-sa1-st1
#@DESCRIPTION: Machine configuration for the refdes-sa1-st1 boards.

#### Preamble
MACHINEOVERRIDES =. "${@['', 'refdes-sa1-st1:']['refdes-sa1-st1' !='${MACHINE}']}"
#### Regular settings follow

# Required generic machine inclusion
require conf/machine/sa1-module.conf
require st1-generic.conf

#### No additional settings should be after the Postamble
#### Postamble
PACKAGE_EXTRA_ARCHS:append = "${@['', 'refdes_sa1_st1']['refdes-sa1-st1' != '${MACHINE}']}"
```

## meta-enclustra-intel/meta-enclustra-module/conf/machine/aa1-module.conf
```bitbake
#@TYPE: Machine
#@NAME: Intel SoCFPGA Arria10
#@DESCRIPTION: Machine configuration for the Arria 10 SoCFPGA

## override preamble
MACHINEOVERRIDES =. "${@['', 'aa1-module:']['aa1-module' != '${MACHINE}']}"

require conf/machine/include/socfpga.inc

SPL_BINARY = "spl/u-boot-splx4.sfp"
UBOOT_BINARY = "u-boot.img"

UBOOT_CONFIG ??= "sdmmc"
UBOOT_CONFIG[sdmmc] = "socfpga_enclustra_mercury_aa1_sdmmc_defconfig"
UBOOT_CONFIG[emmc] = "socfpga_enclustra_mercury_aa1_emmc_defconfig"
#UBOOT_CONFIG[qspi] = "socfpga_enclustra_mercury_aa1_qspi_defconfig"

# TODO rm
#UBOOT_CONFIG[qspi] = "mercury-aa1-qspi_defconfig"
#UBOOT_CONFIG[emmc] = "mercury-aa1-sd_defconfig"
#UBOOT_CONFIG[sdmmc] = "mercury-aa1-sd_defconfig"

# TODO rm
#UBOOT_CONFIG ??= "mercury-aa1-sd"
#UBOOT_CONFIG[mercury-aa1-qspi] = "mercury-aa1-qspi_defconfig"
#UBOOT_CONFIG[mercury-aa1-sd] = "mercury-aa1-sd_defconfig"

KERNEL_IMAGETYPE = "uImage"
KERNEL_EXTRA_ARGS += "LOADADDR=0x8000"

IMAGE_FSTYPES = "cpio.gz.u-boot wic.bmap tar.gz"

EXTRA_IMAGEDEPENDS += "\
	device-tree \
	u-boot-socfpga \
	hw-ref-design \
	"

## NB: use boot.scr due to common u-boot environment, even if there
## are other variables for u-boot.scr around:
##     boot_scripts=boot.scr.uimg boot.scr
IMAGE_BOOT_FILES ?= " \
	devicetree.dtb \
	boot.scr \
	bitstream.itb \
	${UBOOT_BINARY} \
	${KERNEL_IMAGETYPE} \
	"

WKS_FILE ?= "sdimage-aa1.wks"
IMAGE_FSTYPES:append = " wic"

SERIAL_CONSOLES ?= "115200;ttyS0"


## override postamble
PACKAGE_EXTRA_ARCHS:append = "${@['', ' aa1_module']['aa1-module' != "${MACHINE}"]}"
```

## meta-enclustra-intel/meta-enclustra-module/conf/machine/aa1sx270i2-module.conf
```bitbake
#@TYPE: Machine
#@NAME: Intel SoCFPGA Arria10
#@DESCRIPTION: Machine configuration for the Arria 10 SoCFPGA

## override preamble
MACHINEOVERRIDES =. "${@['', 'aa1sx270i2-module:']['aa1sx270i2-module' != '${MACHINE}']}"


require aa1-module.conf


## override postamble
PACKAGE_EXTRA_ARCHS:append = "${@['', ' aa1sx270i2_module']['aa1sx270i2-module' != "${MACHINE}"]}"
```

## meta-enclustra-intel/meta-enclustra-module/conf/machine/sa2-module.conf
```bitbake
#@TYPE: Machine
#@NAME: Intel SoCFPGA CycloneV SA2
#@DESCRIPTION: Machine configuration for the CycloneV SA2 SoCFPGA

## override preamble
MACHINEOVERRIDES =. "${@['', 'sa2-module:']['sa2-module' != '${MACHINE}']}"


require conf/machine/include/socfpga.inc

UBOOT_CONFIG ??= "sdmmc"
UBOOT_CONFIG[sdmmc] = "socfpga_mercury_sa2_qspi_defconfig"
UBOOT_CONFIG[qspi] = "socfpga_mercury_sa2_sdmmc_defconfig"

# TODO rm
#UBOOT_CONFIG[sdmmc] = "mercury-sa2-sd_defconfig"
#UBOOT_CONFIG[qspi] = "mercury-sa2-qspi_defconfig"

## TODO rm
#UBOOT_CONFIG ??= "mercury-sa2-sd"
#UBOOT_CONFIG[mercury-sa2-sd] = "mercury-sa2-sd_defconfig"
#UBOOT_CONFIG[mercury-sa2-qspi] = "mercury-sa2-qspi_defconfig"

KERNEL_IMAGETYPE = "uImage"
KERNEL_EXTRA_ARGS += "LOADADDR=0x8000"

IMAGE_FSTYPES = "cpio.gz.u-boot tar.gz wic.bmap"

EXTRA_IMAGEDEPENDS += "\
	device-tree \
	u-boot-socfpga \
	u-boot-socfpga-scr \
	hw-ref-design \
	"

IMAGE_BOOT_FILES ?= " \
	devicetree.dtb \
	boot-sd.scr \
	fpga.rbf \
	${KERNEL_IMAGETYPE} \
	"

WKS_FILE ?= "sdimage-cyclone5-arria5.wks"
IMAGE_FSTYPES:append = " wic"

SERIAL_CONSOLES ?= "115200;ttyS0"


## override postamble
PACKAGE_EXTRA_ARCHS:append = "${@['', ' sa2_module']['sa2-module' != "${MACHINE}"]}"
```

## meta-enclustra-intel/meta-enclustra-refdes/conf/machine/refdes-aa1sx270i2-pe1.conf
```bitbake
#@TYPE: Machine
#@NAME: refdes-aa1sx270i2-pe1
#@DESCRIPTION: Machine configuration for the refdes-aa1sx270i2-pe1 boards.

#### Preamble
MACHINEOVERRIDES =. "${@['', 'refdes-aa1sx270i2-pe1:']['refdes-aa1sx270i2-pe1' !='${MACHINE}']}"
#### Regular settings follow

# Required generic machine inclusion
require conf/machine/aa1sx270i2-module.conf
require conf/machine/pe1-generic.conf

#### No additional settings should be after the Postamble
#### Postamble
PACKAGE_EXTRA_ARCHS:append = "${@['', 'refdes_aa1sx270i2_pe1']['refdes-aa1sx270i2-pe1' != '${MACHINE}']}"
```

## meta-enclustra-intel/meta-enclustra-refdes/conf/machine/refdes-sa2-pe1.conf
```bitbake
#@TYPE: Machine
#@NAME: refdes-sa2-pe1
#@DESCRIPTION: Machine configuration for the refdes-sa2-pe1 boards.

#### Preamble
MACHINEOVERRIDES =. "${@['', 'refdes-sa2-pe1:']['refdes-sa2-pe1' !='${MACHINE}']}"
#### Regular settings follow

# Required generic machine inclusion
require conf/machine/sa2-module.conf
require conf/machine/pe1-generic.conf

#### No additional settings should be after the Postamble
#### Postamble
PACKAGE_EXTRA_ARCHS:append = "${@['', 'refdes_sa2_pe1']['refdes-sa2-pe1' != '${MACHINE}']}"
```

## meta-enclustra-intel/meta-enclustra_baseboard/conf/machine/refdes-aa1sx270e3-pe1.conf
```bitbake
#@TYPE: Machine
#@NAME: refdes-aa1sx270e3-pe1
#@DESCRIPTION: Machine configuration for the refdes-aa1sx270e3-pe1 boards.

#### Preamble
MACHINEOVERRIDES =. "${@['', 'refdes-aa1sx270e3-pe1:']['refdes-aa1sx270e3-pe1' !='${MACHINE}']}"
#### Regular settings follow

# Required generic machine inclusion
require conf/machine/aa1sx270e3-module.conf
require pe1-generic.conf

#### No additional settings should be after the Postamble
#### Postamble
PACKAGE_EXTRA_ARCHS:append = "${@['', 'refdes_aa1sx270e3_pe1']['refdes-aa1sx270e3-pe1' != '${MACHINE}']}"
```

## meta-enclustra-intel/meta-enclustra_baseboard/conf/machine/refdes-aa1sx480i2-pe3.conf
```bitbake
#@TYPE: Machine
#@NAME: refdes-aa1sx480i2-pe3
#@DESCRIPTION: Machine configuration for the refdes-aa1sx480i2-pe3 boards.

#### Preamble
MACHINEOVERRIDES =. "${@['', 'refdes-aa1sx480i2-pe3:']['refdes-aa1sx480i2-pe3' !='${MACHINE}']}"
#### Regular settings follow

# Required generic machine inclusion
require conf/machine/aa1sx480i2-module.conf
require pe3-generic.conf

#### No additional settings should be after the Postamble
#### Postamble
PACKAGE_EXTRA_ARCHS:append = "${@['', 'refdes_aa1sx480i2_pe3']['refdes-aa1sx480i2-pe3' != '${MACHINE}']}"
```

## meta-enclustra-intel/meta-enclustra_baseboard/conf/machine/refdes-sa1-pe3.conf
```bitbake
#@TYPE: Machine
#@NAME: refdes-sa1-pe3
#@DESCRIPTION: Machine configuration for the refdes-sa1-pe3 boards.

#### Preamble
MACHINEOVERRIDES =. "${@['', 'refdes-sa1-pe3:']['refdes-sa1-pe3' !='${MACHINE}']}"
#### Regular settings follow

# Required generic machine inclusion
require conf/machine/sa1-module.conf
require pe3-generic.conf

#### No additional settings should be after the Postamble
#### Postamble
PACKAGE_EXTRA_ARCHS:append = "${@['', 'refdes_sa1_pe3']['refdes-sa1-pe3' != '${MACHINE}']}"
```

## meta-enclustra-intel/meta-enclustra_module/conf/machine/aa1sx270e3-module.conf
```bitbake
#@TYPE: Machine
#@NAME: Intel SoCFPGA Arria10
#@DESCRIPTION: Machine configuration for the Arria 10 SoCFPGA

## override preamble
MACHINEOVERRIDES =. "${@['', 'aa1sx270e3-module:']['aa1sx270e3-module' != '${MACHINE}']}"


require aa1-module.conf


## override postamble
PACKAGE_EXTRA_ARCHS:append = "${@['', ' aa1sx270e3_module']['aa1sx270e3-module' != "${MACHINE}"]}"
```

## meta-enclustra-intel/meta-enclustra_module/conf/machine/aa1sx480i2-module.conf
```bitbake
#@TYPE: Machine
#@NAME: Intel SoCFPGA Arria10
#@DESCRIPTION: Machine configuration for the Arria 10 SoCFPGA

## override preamble
MACHINEOVERRIDES =. "${@['', 'aa1sx480i2-module:']['aa1sx480i2-module' != '${MACHINE}']}"


require aa1-module.conf


## override postamble
PACKAGE_EXTRA_ARCHS:append = "${@['', ' aa1sx480i2_module']['aa1sx480i2-module' != "${MACHINE}"]}"
```

## meta-enclustra-intel/meta-enclustra_module/conf/machine/mercury-aa1.conf
```bitbake
#@TYPE: Machine
#@NAME: Intel SoCFPGA Arria10
#@DESCRIPTION: Machine configuration for the Arria 10 SoCFPGA

require conf/machine/include/socfpga.inc

SPL_BINARY = "spl/u-boot-splx4.sfp"
UBOOT_BINARY = "u-boot.img"

UBOOT_CONFIG ??= "mercury-aa1-sd"
UBOOT_CONFIG[mercury-aa1-qspi] = "mercury-aa1-qspi_defconfig"
UBOOT_CONFIG[mercury-aa1-sd] = "mercury-aa1-sd_defconfig"

KERNEL_IMAGETYPE = "uImage"
KERNEL_EXTRA_ARGS += "LOADADDR=0x8000"

IMAGE_FSTYPES = "cpio.gz.u-boot wic.bmap tar.gz"

EXTRA_IMAGEDEPENDS += "\
	device-tree \
	u-boot-socfpga \
	u-boot-socfpga-env \
	u-boot-socfpga-scr \
	hw-ref-design \
	"

IMAGE_BOOT_FILES ?= " \
	devicetree.dtb \
	boot-sd.scr \
	uboot.env \
	fit_spl_fpga.itb \
	${UBOOT_BINARY} \
	${KERNEL_IMAGETYPE} \
	"

WKS_FILE ?= "sdimage-arria10.wks"
IMAGE_FSTYPES:append = " wic"

SERIAL_CONSOLES ?= "115200;ttyS0"
```

## meta-enclustra-intel/meta-enclustra_module/conf/machine/sa1-module.conf
```bitbake
#@TYPE: Machine
#@NAME: Intel SoCFPGA CycloneV SA1
#@DESCRIPTION: Machine configuration for the Cyclone V SA1 SoCFPGA

## override preamble
MACHINEOVERRIDES =. "${@['', 'sa1-module:']['sa1-module' != '${MACHINE}']}"


require conf/machine/include/socfpga.inc

UBOOT_CONFIG ??= "sdmmc"
UBOOT_CONFIG[sdmmc] = "mercury-sa1-sd_defconfig"
UBOOT_CONFIG[emmc] = "mercury-sa1-sd_defconfig"
UBOOT_CONFIG[qspi] = "mercury-sa1-qspi_defconfig"

## TODO rm
#UBOOT_CONFIG ??= "mercury-sa1-sd"
#UBOOT_CONFIG[mercury-sa1-sd] = "mercury-sa1-sd_defconfig"
#UBOOT_CONFIG[mercury-sa1-emmc] = "mercury-sa1-sd_defconfig"
#UBOOT_CONFIG[mercury-sa1-qspi] = "mercury-sa1-qspi_defconfig"

KERNEL_IMAGETYPE = "uImage"
KERNEL_EXTRA_ARGS += "LOADADDR=0x8000"

IMAGE_FSTYPES = "cpio.gz.u-boot tar.gz wic.bmap"

EXTRA_IMAGEDEPENDS += "\
	device-tree \
	u-boot-socfpga \
	u-boot-socfpga-scr \
	hw-ref-design \
	"

IMAGE_BOOT_FILES ?= " \
	devicetree.dtb \
	boot-sd.scr \
	fpga.rbf \
	${KERNEL_IMAGETYPE} \
	"

WKS_FILE ?= "sdimage-cyclone5-arria5.wks"
IMAGE_FSTYPES:append = " wic"

SERIAL_CONSOLES ?= "115200;ttyS0"


## override postamble
PACKAGE_EXTRA_ARCHS:append = "${@['', ' sa1_module']['sa1-module' != "${MACHINE}"]}"
```

## meta-enclustra-intel/meta-enclustra_refdes/conf/layer.conf
```bitbake
BBPATH .= ":${LAYERDIR}"

BBFILES += " \
${LAYERDIR}/recipes-*/*/*.bb \
${LAYERDIR}/recipes-*/*/*.bbappend \
"

BBFILE_COLLECTIONS += "meta-enclustra-refdes"
BBFILE_PATTERN_meta-enclustra-refdes = "^${LAYERDIR}/"
BBFILE_PRIORITY_meta-enclustra-refdes = "10"

LAYERVERSION = "1"
LAYERDEPENDS_meta-enclustra-refdes += "meta-enclustra-module"

LAYERSERIES_COMPAT_meta-enclustra-refdes = "mickledore"
```

## meta-enclustra-module/conf/machine/me-aa1-270-2i2-d11e-nfx3.conf
```bitbake
#@TYPE: Machine
#@NAME: Intel SoCFPGA Arria10
#@DESCRIPTION: Machine configuration for the Arria 10 SoCFPGA

## override preamble
MACHINEOVERRIDES =. "${@['', 'me-aa1-270-2i2-d11e-nfx3:']['me-aa1-270-2i2-d11e-nfx3' != '${MACHINE}']}"


require me-aa1-generic.conf


## override postamble
PACKAGE_EXTRA_ARCHS:append = "${@['', ' me-aa1-270-2i2-d11e-nfx3']['me-aa1-270-2i2-d11e-nfx3' != "${MACHINE}"]}"
```

## meta-enclustra-module/conf/machine/me-aa1-480-2i3-d12d-nfx3.conf
```bitbake
#@TYPE: Machine
#@NAME: Intel SoCFPGA Arria10
#@DESCRIPTION: Machine configuration for the Arria 10 SoCFPGA

## override preamble
MACHINEOVERRIDES =. "${@['', 'me-aa1-480-2i3-d12d-nfx3:']['me-aa1-480-2i3-d12d-nfx3' != '${MACHINE}']}"


require me-aa1-generic.conf


## override postamble
PACKAGE_EXTRA_ARCHS:append = "${@['', ' me-aa1-480-2i3-d12d-nfx3']['me-aa1-480-2i3-d12d-nfx3' != "${MACHINE}"]}"
```

## meta-enclustra-module/conf/machine/me-aa1-generic.conf
```bitbake
#@TYPE: Machine
#@NAME: Intel SoCFPGA Arria10
#@DESCRIPTION: Machine configuration for the Arria 10 SoCFPGA

## override preamble
MACHINEOVERRIDES =. "${@['', 'me-aa1-generic:']['me-aa1-generic' != '${MACHINE}']}"

require conf/machine/include/socfpga.inc

SPL_BINARY = "spl/u-boot-splx4.sfp"
UBOOT_BINARY = "u-boot.img"

UBOOT_CONFIG ??= "sdmmc"
UBOOT_CONFIG[sdmmc] = "socfpga_enclustra_mercury_aa1_defconfig"
UBOOT_CONFIG[emmc]  = "socfpga_enclustra_mercury_aa1_defconfig"
UBOOT_CONFIG[qspi] = "socfpga_enclustra_mercury_aa1_defconfig"

KERNEL_IMAGETYPE = "uImage"
KERNEL_EXTRA_ARGS += "LOADADDR=0x8000"

IMAGE_FSTYPES = "cpio.gz.u-boot wic.bmap tar.gz"

EXTRA_IMAGEDEPENDS += "\
    device-tree \
    u-boot-socfpga \
    hw-ref-design \
"

## NB: use boot.scr due to common u-boot environment, even if there
## are other variables for u-boot.scr around:
##     boot_scripts=boot.scr.uimg boot.scr
IMAGE_BOOT_FILES ?= " \
    devicetree.dtb \
    socfpga_enclustra_mercury_emmc_overlay.dtbo \
    socfpga_enclustra_mercury_qspi_overlay.dtbo \
    socfpga_enclustra_mercury_sdmmc_overlay.dtbo \
    boot.scr \
    bitstream.itb \
    ${UBOOT_BINARY} \
    ${KERNEL_IMAGETYPE} \
"

WKS_FILE ?= "sdimage-aa1.wks"
IMAGE_FSTYPES:append = " wic"

SERIAL_CONSOLES ?= "115200;ttyS0"


## override postamble
PACKAGE_EXTRA_ARCHS:append = "${@['', ' me-aa1-generic']['me-aa1-generic' != "${MACHINE}"]}"
```

## meta-enclustra-module/conf/machine/me-sa1-c6-7i-d10.conf
```bitbake
#@TYPE: Machine
#@NAME: Intel SoCFPGA CycloneV SA1
#@DESCRIPTION: Machine configuration for the Cyclone V SA1 SoCFPGA

## override preamble
MACHINEOVERRIDES =. "${@['', 'me-sa1-c6-7i-d10:']['me-sa1-c6-7i-d10' != '${MACHINE}']}"


require me-sa1-generic.conf


## override postamble
PACKAGE_EXTRA_ARCHS:append = "${@['', ' me-sa1-c6-7i-d10']['me-sa1-c6-7i-d10' != "${MACHINE}"]}"
```
