/* AUTOGENERATED FILE - DO NOT MODIFY */
/* This file is created by Enclustra Build Environment */

/dts-v1/;

#include "ME-AA1-270-2I2-D11E-NFX3.dtsi"
#include "socfpga_arria10.dtsi"
#include "socfpga_arria10-u-boot.dtsi"
#include "socfpga_arria10_handoff.h"
#include "socfpga_arria10-handoff.dtsi"
#include "socfpga_arria10_handoff_u-boot.dtsi"
#include "socfpga_enclustra_mercury_aa1.dtsi"
#include "socfpga_enclustra_mercury_aa1_UBOOT_CONFIG_boot.dtsi"
