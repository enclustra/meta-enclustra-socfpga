// SPDX-License-Identifier: GPL-2.0+ OR MIT
/*
 * Copyright (C) 2024 Enclustra GmbH - https://www.enclustra.com
 */

/dts-v1/;

#include "socfpga_arria10.dtsi"
#include "socfpga_arria10-u-boot.dtsi"
#include "socfpga_arria10_handoff.h"
#include "socfpga_arria10-handoff.dtsi"
#include "socfpga_arria10_handoff_u-boot.dtsi"
#include "socfpga_enclustra_mercury_aa1.dtsi"
#include "socfpga_enclustra_mercury_aa1_XXX_boot.dtsi"
#include "socfpga_enclustra_mercury_pe1.dtsi"
#include "ME-AA1-480-2I3-D12E-NFX3.dtsi"
