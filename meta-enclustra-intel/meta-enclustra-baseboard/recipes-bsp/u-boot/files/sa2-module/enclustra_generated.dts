// SPDX-License-Identifier: GPL-2.0+ OR MIT
/*
 * Copyright (C) 2023 Enclustra GmbH - https://www.enclustra.com
 */

/dts-v1/;

#include "socfpga_cyclone5.dtsi"
#include "socfpga-common-u-boot.dtsi"
#include "socfpga_enclustra_mercury_sa2.dtsi"
// TODO baseboard needed for u-boot?
//#include "socfpga_enclustra_mercury_st1.dtsi"
#include "ME-SA2-D6-7I-D11.dtsi"

// TODO legacy
//#include "ME-SA2-D6-7I-D11.dtsi"
//#include "socfpga_cyclone5.dtsi"
//#include "socfpga-common-u-boot.dtsi"
//#include "socfpga_enclustra_mercury_sa2.dtsi"
