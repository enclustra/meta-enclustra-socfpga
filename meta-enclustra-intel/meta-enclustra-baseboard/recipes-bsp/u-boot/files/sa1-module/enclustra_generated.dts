// SPDX-License-Identifier: GPL-2.0+ OR MIT
/*
 * Copyright (C) 2023 Enclustra GmbH - https://www.enclustra.com
 */

/dts-v1/;

#include "socfpga_cyclone5.dtsi"
#include "socfpga-common-u-boot.dtsi"
#include "socfpga_enclustra_mercury_sa1.dtsi"
// TODO baseboard needed for u-boot?
//#include "socfpga_enclustra_mercury_pe1.dtsi"
#include "ME-SA1-C6-7I-D10.dtsi"

// TODO rm
//#include "ME-SA1-C6-7I-D10.dtsi"
//#include "socfpga_cyclone5.dtsi"
//#include "socfpga-common-u-boot.dtsi"
//#include "socfpga_enclustra_mercury_sa1.dtsi"
